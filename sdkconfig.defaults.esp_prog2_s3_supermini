## sdkconfig.defaults.esp_prog2_s3_supermini
```kconfig
# This file is used to pass ESP-Prog-2 specific options when building firmware for the probe
# To pass it to the build system, set the SDKCONFIG_DEFAULTS environment environment variable like so:
# export SDKCONFIG_DEFAULTS="sdkconfig.defaults.esp_prog2_s3_supermini;sdkconfig.defaults.esp32s3"

CONFIG_BRIDGE_PRODUCT_NAME="tbay-prog"

# Swapped serial and debug pins to make serial usable on supermini
# Run on NixOS e.g. with:
# nix --experimental-features 'nix-command flakes' develop github:mirrexagon/nixpkgs-esp-dev#esp-idf-full
# ...and then the commands in the README. Remember to include this file (instructions above)
CONFIG_SERIAL_HANDLER_GPIO_BOOT=7
CONFIG_SERIAL_HANDLER_GPIO_RST=6
CONFIG_SERIAL_HANDLER_GPIO_RXD=5
CONFIG_SERIAL_HANDLER_GPIO_TXD=4

CONFIG_DEBUG_PROBE_GPIO_TDI=33
CONFIG_DEBUG_PROBE_GPIO_TDO=21
CONFIG_DEBUG_PROBE_GPIO_TCK=18
CONFIG_DEBUG_PROBE_GPIO_TMS=17

CONFIG_BRIDGE_GPIO_LED1=48
CONFIG_BRIDGE_GPIO_LED2=34
CONFIG_BRIDGE_GPIO_LED3=34
CONFIG_BRIDGE_GPIO_LED1_ACTIVE=0
CONFIG_BRIDGE_GPIO_LED2_ACTIVE=0
CONFIG_BRIDGE_GPIO_LED3_ACTIVE=0
```
